/*
    http://www.mrobot.by
    http://www.maxxlife.by
    http://www.vk.com/cookrobot
    Copyright (c) Кухня роботов <maxxlife.by> All rights reserved.
    Copyright (c) Макслайф Робот Maxxlife Robot All rights reserved.

    Наши лаборатории по робототехнике:
    Ленинская РОС ДОСААФ, ул. Рокоссовского 63/2, Минск, Беларусь
    Подробнее в нашей группе Вконтакте http://www.vk.com/cookrobot
    И на сайте http://www.maxxlife.by

    ****************************************************
    Мы всегда рады новым членам нашего сообщества Кухня Роботов.
    У нас есть бесплатные вводные курсы, где мы объясняем
    как работать с нашими образовательными наборами по робототехнике и электронике.
    ****************************************************

    Название набора: Набор Роботов А1
    Описание: Схема 10 Многоцветный RGB-светодиод 

    Программа создана и протестирована разработчиком:
    Имя: Максим Массальский
    Ник: maxxlife
    E-mail: maxxliferobot@gmail.com
    Дата разработки: 30.08.2015
*/

// Создание массива из трех значений, определяющих пины RGB светодиода
// В массиве хранятся номера трех цифровых выводов 
// для подключения светодиода к плате
int ledDigitalOne[] = {9, 10, 11};

// Переменная типа boolean ON хранит в себе значение HIGH
// Используется для выставления на одном из выводов платы высокого уровня напряжения HIGH
const boolean ON = HIGH;  
// Ключевое слово const говорит о том, что это переменная-константа
// Поэтому значение данной переменной в программе изменить нельзя

// Переменная типа boolean OFF хранит в себе значение LOW
// Используется для выставления на одном из выводов платы низкого уровня напряжения LOW
const boolean OFF = LOW;   

// Ниже приведены массивы данных для настройки цвета свечения светодиода.
// Цвет будет зависеть от того, 
// на какие выводы светодиода будет подано определенное значение напряжения.
// Например, чтобы создать красный цвет RED необходимо подать
// на 9 вывод HIGH, на 10 вывод LOW, на 11 вывод LOW.
// Для реализации используется цикл for. Смотри void loop()
const boolean RED[] = {ON, OFF, OFF};    
const boolean GREEN[] = {OFF, ON, OFF}; 
const boolean BLUE[] = {OFF, OFF, ON}; 
const boolean YELLOW[] = {ON, ON, OFF}; 
const boolean CYAN[] = {OFF, ON, ON}; 
const boolean MAGENTA[] = {ON, OFF, ON}; 
const boolean WHITE[] = {ON, ON, ON}; 
const boolean BLACK[] = {OFF, OFF, OFF}; 

void setup() 
{
  // Инициализируем цифровые пины 9, 10, 11 на выход
  // Для упрощения инициализации используется цикл for
  for (int i = 0; i < 3; i++) 
  {
    pinMode(ledDigitalOne[i], OUTPUT);  
  }
}

void loop()
{
  
// Цикл for в котором на определенный цифровой вывод, 
// подается определенной значение из массива с цветом
// Т.е. на три вывода подается три значения при помощи цикла for

// В данном цикле мы создаем красный цвет RED
  for(int i=0;i<3;i++)
  {
   digitalWrite(ledDigitalOne[i],RED[i]);
  }
    // Задержка 3 секунды перед сменой цвета.
  delay(3000);
  
  // В данном цикле мы создаем зеленый цвет GREEN
  for(int i=0;i<3;i++)
  {
   digitalWrite(ledDigitalOne[i],GREEN[i]);
  }
      // Задержка 3 секунды перед сменой цвета.
  delay(3000);
  
   // В данном цикле мы создаем голубой цвет CYAN
  for(int i=0;i<3;i++)
  {
   digitalWrite(ledDigitalOne[i],CYAN[i]);
  }
      // Задержка 3 секунды перед сменой цвета.
  delay(3000);
  
   // В данном цикле мы создаем розовый цвет MAGENTA
  for(int i=0;i<3;i++)
  {
   digitalWrite(ledDigitalOne[i],MAGENTA[i]);
  }
      // Задержка 3 секунды перед сменой цвета.
  delay(3000);
  // Ты можешь оставить всего лишь один цикл for, а все остальные удалить из void loop()
  // Тогда твой светодиод будет постоянно светится одним цветом.
}

